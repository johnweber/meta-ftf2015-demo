## conf/layer.conf
```bitbake
# We have a conf and classes directory, add to BBPATH
BBPATH .= ":${LAYERDIR}"

# We have a packages directory, add to BBFILES
BBFILES += "${LAYERDIR}/recipes-*/*/*.bb \
            ${LAYERDIR}/recipes-*/*/*.bbappend"

BBFILE_COLLECTIONS += "ftf2015-demo"
BBFILE_PATTERN_ftf2015-demo := "^${LAYERDIR}/"
BBFILE_PRIORITY_ftf2015-demo = "6"
```

## conf/machine/picosom.conf
```bitbake
#@TYPE: Machine
#@NAME: PicoSOM i.MX6
#@SOC: i.MX6DL/S
#@DESCRIPTION: Machine configuration for i.MX6 PicoSOM Solo/Duallite
#@MAINTAINER: John Weber

include conf/machine/include/imx-base.inc
include conf/machine/include/tune-cortexa9.inc

SOC_FAMILY = "mx6:mx6dl"

PREFERRED_PROVIDER_u-boot = "u-boot-technexion"
PREFERRED_PROVIDER_virtual/kernel ?= "linux-technexion"
PREFERRED_VERSION_linux-technexion ?= "3.10.53"

SERIAL_CONSOLE = "115200 ttymxc0"

MACHINE_FEATURES += "pci touchscreen"

KERNEL_IMAGETYPE = "zImage"

UBOOT_MACHINE = "picosom-imx6_defconfig"
#SPL_BINARY = "SPL"

KERNEL_DEVICETREE = "imx6dl-picosom.dtb"

MACHINE_FEATURES += "bluetooth wifi"

#MACHINE_EXTRA_RRECOMMENDS += " \
#  bcm4329-nvram-config \
#  bcm4330-nvram-config \
#"
```
